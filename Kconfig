## Kconfig
```kconfig
config ZMK_BEHAVIOR_CHEONJIIN
    bool "Enable Cheonjiin input behavior"
    default y
```

## boards/Kconfig
```kconfig
menu "Sinlain Cheonjiin Behavior"

config ZMK_BEHAVIOR_CHEONJIIN
    bool "Enable Cheonjiin input behavior"
    default y
    depends on ZMK

endmenu
```

## dts/bindings/behaviors/sinlain,behavior-cheonjiin.yaml
```yaml
description: Cheonjiin Korean input behavior

compatible: "sinlain,behavior-cheonjiin"

include: one_param.yaml
```
